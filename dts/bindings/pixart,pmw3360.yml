## dts/bindings/pixart,pmw3360.yml
```yaml
description: |
  Sensor driver for the pixart PMW3660 mouse sensor 

compatible: "src,pmw3660"

include: spi-device.yaml

properties:
  irq-gpios:
    type: phandle-array
    required: true
  scroll-layers:
    type: array
    default: []
  snipe-layers:
    type: array
    default: []
  automouse-layer:
    type: int
    default: -1
```
